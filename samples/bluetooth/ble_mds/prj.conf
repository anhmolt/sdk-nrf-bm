## Kconfig
```
#
# Copyright (c) 2026 Nordic Semiconductor ASA
#
# SPDX-License-Identifier: LicenseRef-Nordic-5-Clause
#

menu "Bluetooth LE MDS sample"

config SAMPLE_BLE_DEVICE_NAME
	string "Device name"
	default "Nordic_Memfault"

config SAMPLE_BLE_MDS_BATTERY_LEVEL_MEAS_INTERVAL
	int "Battery level measurement interval (ms)"
	default 1000
	help
	  Battery level measurement interval in milliseconds.

config SAMPLE_BLE_MDS_RUN_LED_BLINK_INTERVAL
	int "Run LED blink interval (ms)"
	default 1000
	help
	  Run status LED blink interval in milliseconds.

module=SAMPLE_BLE_MDS
module-str=BLE Memfault Diagnostic Service Sample
source "$(ZEPHYR_BASE)/subsys/logging/Kconfig.template.log_config"

endmenu # "Bluetooth LE MDS sample"

#
# Firmware version and device identification
#
# The application :file:`VERSION` file is the single source of truth for the
# firmware revision. Kconfig defaults below propagate that value to Memfault
# and the Bluetooth Device Information Service (DIS).
#
# | Field             | Memfault (NCS)              | Bluetooth DIS              |
# |-------------------|-----------------------------|----------------------------|
# | software_version  | MEMFAULT_NCS_FW_VERSION     | BLE_DIS_FW_REVISION        |
# | software_type     | MEMFAULT_NCS_FW_TYPE        | BLE_DIS_SW_REVISION        |
# | hardware_version  | MEMFAULT_NCS_HW_VERSION     | BLE_DIS_HW_REVISION        |
# | device_serial     | MEMFAULT_NCS_DEVICE_ID      | BLE_DIS_SERIAL_NUMBER      |
#
# Memfault uses the NCS built-in device info implementation
# (:kconfig:option:`CONFIG_MEMFAULT_NCS_DEVICE_INFO_BUILTIN`), not the Memfault
# SDK :kconfig:option:`CONFIG_MEMFAULT_BUILTIN_DEVICE_INFO_SOFTWARE_VERSION`
# option. Enable :kconfig:option:`CONFIG_MEMFAULT_NCS_FW_VERSION_STATIC` in
# :file:`prj.conf` so the version from the :file:`VERSION` file is reported
# instead of the default dynamic ``<prefix>+<build-id>`` string.
#
# Keep ``source "Kconfig.zephyr"`` at the end of this file so these defaults
# take precedence.

config MEMFAULT_NCS_FW_VERSION
	default "$(APPVERSION)"

config BLE_DIS_FW_REVISION
	default MEMFAULT_NCS_FW_VERSION

config MEMFAULT_NCS_FW_TYPE
	default "app"

config BLE_DIS_SW_REVISION
	default MEMFAULT_NCS_FW_TYPE

config MEMFAULT_NCS_HW_VERSION
	default "hw 54.15.0"

config BLE_DIS_HW_REVISION
	default MEMFAULT_NCS_HW_VERSION

#
# Handle increased buffersize when MEMFAULT Logging is enabled
#

config MEMFAULT_LOGGING_RAM_SIZE
	default 1024 if MEMFAULT_LOGGING_ENABLE


source "Kconfig.zephyr"
```

## prj.conf
```kconfig
# Logging
CONFIG_LOG=y
CONFIG_LOG_BACKEND_BM_UARTE=y

# SoftDevice
CONFIG_SOFTDEVICE=y
CONFIG_NRF_SDH_BLE_VS_UUID_COUNT=1
CONFIG_NRF_SDH_BLE_GATT_MAX_MTU_SIZE=247

# Enable RNG
CONFIG_PSA_CRYPTO=y
CONFIG_PSA_WANT_GENERATE_RANDOM=y

# Advertising library
CONFIG_BLE_ADV=y

# BLE connection parameters
CONFIG_BLE_CONN_PARAMS=y
CONFIG_BLE_CONN_PARAMS_DATA_LENGTH_TX=251
CONFIG_BLE_CONN_PARAMS_DATA_LENGTH_RX=251
CONFIG_BLE_CONN_PARAMS_INITIATE_ATT_MTU_EXCHANGE=y
CONFIG_BLE_CONN_PARAMS_INITIATE_DATA_LENGTH_UPDATE=y

# Device information service (FW/HW/SW revisions come from VERSION + Kconfig)
CONFIG_BLE_DIS=y
CONFIG_BLE_DIS_SERIAL_NUMBER="ABCD"

# Battery service
CONFIG_BLE_BAS=y

# Memfault Diagnostic Service
CONFIG_BLE_MDS=y

# Buttons and timers
CONFIG_BM_TIMER=y
CONFIG_BM_BUTTONS=y
CONFIG_BM_GPIOTE=y

# Memfault
CONFIG_MEMFAULT=y

CONFIG_MEMFAULT_LOGGING_ENABLE=n
# CONFIG_MEMFAULT_LOG_LEVEL_WRN=y
CONFIG_MEMFAULT_NCS_STACK_METRICS=n
CONFIG_MEMFAULT_METRICS_DEFAULT_SET_ENABLE=n
CONFIG_MEMFAULT_METRICS_THREADS=n
CONFIG_MEMFAULT_METRICS_TIMER_CUSTOM=y
CONFIG_MEMFAULT_REBOOT_REASON_GET_BASIC=y
CONFIG_MEMFAULT_SOFTWARE_WATCHDOG_CUSTOM=y
CONFIG_MEMFAULT_COREDUMP_COLLECT_KERNEL_REGION=n
CONFIG_MEMFAULT_COREDUMP_COLLECT_TASKS_REGIONS=n
CONFIG_MEMFAULT_EVENT_STORAGE_SIZE=2048

CONFIG_MEMFAULT_NCS_PROJECT_KEY="4gH6xLgd0X3J4JnpJQxtvxNGncBCS7AH"
CONFIG_MEMFAULT_NCS_FW_VERSION_STATIC=y
CONFIG_MEMFAULT_NCS_DEVICE_ID_HW_ID=y
CONFIG_HW_ID_LIBRARY_SOURCE_DEVICE_ID=y
```

## src/main.c
```c
/*
 * Copyright (c) 2026 Nordic Semiconductor ASA
 *
 * SPDX-License-Identifier: LicenseRef-Nordic-5-Clause
 */

#include <stdint.h>
#include <stdbool.h>
#include <string.h>

#include <ble_gap.h>
#include <ble_hci.h>
#include <ble_types.h>
#include <hal/nrf_gpio.h>
#include <nrf_error.h>
#include <nrf_soc.h>

#include <bm/bm_buttons.h>
#include <bm/bm_timer.h>
#include <bm/bluetooth/ble_adv.h>
#include <bm/bluetooth/ble_conn_params.h>
#include <bm/bluetooth/services/ble_bas.h>
#include <bm/bluetooth/services/ble_dis.h>
#include <bm/bluetooth/services/ble_mds.h>
#include <bm/bluetooth/services/uuid.h>
#include <bm/softdevice_handler/nrf_sdh.h>
#include <bm/softdevice_handler/nrf_sdh_ble.h>

#include <memfault/core/trace_event.h>
#include <memfault/metrics/metrics.h>
#include <memfault/metrics/platform/timer.h>

#include <zephyr/kernel.h>
#include <zephyr/logging/log.h>
#include <zephyr/logging/log_ctrl.h>
#include <zephyr/sys/util.h>

#include <board-config.h>

LOG_MODULE_REGISTER(sample, CONFIG_SAMPLE_BLE_MDS_LOG_LEVEL);

#define RUN_STATUS_LED BOARD_PIN_LED_0
#define CON_STATUS_LED BOARD_PIN_LED_1
#define BATTERY_LEVEL_MAX 100U

BLE_ADV_DEF(ble_adv); /* BLE advertising instance */
BLE_BAS_DEF(ble_bas); /* BLE battery service instance */
BLE_MDS_DEF(ble_mds); /* BLE Memfault Diagnostic Service instance */

static uint16_t conn_handle = BLE_CONN_HANDLE_INVALID;
static uint8_t battery_level = BATTERY_LEVEL_MAX;

static struct bm_timer battery_timer;

static volatile bool memfault_heartbeat_pending;

#if IS_ENABLED(CONFIG_MEMFAULT_METRICS_TIMER_CUSTOM)
static struct bm_timer memfault_metrics_timer;
static MemfaultPlatformTimerCallback *memfault_metrics_timer_cb;
static volatile bool memfault_metrics_timer_due;

static void memfault_metrics_timer_timeout_handler(void *context)
{
	ARG_UNUSED(context);

	memfault_metrics_timer_due = true;
}

bool memfault_platform_metrics_timer_boot(uint32_t period_sec,
					  MemfaultPlatformTimerCallback callback)
{
	int err;
	uint32_t period_ms;

	if ((period_sec == 0U) || (callback == NULL)) {
		return false;
	}

	memfault_metrics_timer_cb = callback;

	err = bm_timer_init(&memfault_metrics_timer, BM_TIMER_MODE_REPEATED,
			    memfault_metrics_timer_timeout_handler);
	if (err) {
		return false;
	}

	period_ms = period_sec * 1000U;
	err = bm_timer_start(&memfault_metrics_timer, BM_TIMER_MS_TO_TICKS(period_ms), NULL);

	return err == 0;
}

static void memfault_metrics_timer_process(void)
{
	if (!memfault_metrics_timer_due || (memfault_metrics_timer_cb == NULL)) {
		return;
	}

	memfault_metrics_timer_due = false;
	memfault_metrics_timer_cb();
}
#else
static void memfault_metrics_timer_process(void)
{
}
#endif

static void leds_init(void)
{
	nrf_gpio_cfg_output(RUN_STATUS_LED);
	nrf_gpio_cfg_output(CON_STATUS_LED);
	nrf_gpio_pin_write(RUN_STATUS_LED, !BOARD_LED_ACTIVE_STATE);
	nrf_gpio_pin_write(CON_STATUS_LED, !BOARD_LED_ACTIVE_STATE);
}

static void battery_level_timeout_handler(void *context)
{
	uint32_t nrf_err;
	int err;

	ARG_UNUSED(context);

	if (battery_level == 0U) {
		battery_level = BATTERY_LEVEL_MAX;
	} else {
		battery_level--;
	}

	err = MEMFAULT_METRIC_SET_UNSIGNED(battery_soc_pct, battery_level);
	if (err) {
		LOG_ERR("Failed to set battery_soc_pct metric, err %d", err);
	}

	nrf_err = ble_bas_battery_level_update(&ble_bas, conn_handle, battery_level);
	if ((nrf_err != NRF_SUCCESS) &&
	    (nrf_err != BLE_ERROR_INVALID_CONN_HANDLE) &&
	    (nrf_err != NRF_ERROR_INVALID_STATE) &&
	    (nrf_err != BLE_ERROR_GATTS_SYS_ATTR_MISSING)) {
		LOG_ERR("Failed to update battery level, nrf_error %#x", nrf_err);
	}
}

static void on_ble_evt(const ble_evt_t *evt, void *ctx)
{
	uint32_t nrf_err;

	ARG_UNUSED(ctx);

	switch (evt->header.evt_id) {
	case BLE_GAP_EVT_CONNECTED:
		LOG_INF("Peer connected");
		conn_handle = evt->evt.gap_evt.conn_handle;
		nrf_gpio_pin_write(CON_STATUS_LED, BOARD_LED_ACTIVE_STATE);

		nrf_err = sd_ble_gatts_sys_attr_set(conn_handle, NULL, 0, 0);
		if (nrf_err) {
			LOG_ERR("Failed to set system attributes, nrf_error %#x", nrf_err);
		}
		break;

	case BLE_GAP_EVT_DISCONNECTED:
		LOG_INF("Peer disconnected, reason %#x",
			evt->evt.gap_evt.params.disconnected.reason);
		if (conn_handle == evt->evt.gap_evt.conn_handle) {
			conn_handle = BLE_CONN_HANDLE_INVALID;
		}
		nrf_gpio_pin_write(CON_STATUS_LED, !BOARD_LED_ACTIVE_STATE);
		break;

	case BLE_GAP_EVT_AUTH_STATUS:
		LOG_INF("Authentication status: %#x",
			evt->evt.gap_evt.params.auth_status.auth_status);
		break;

	case BLE_GAP_EVT_SEC_PARAMS_REQUEST:
		/* Pairing is not required by this sample. */
		nrf_err = sd_ble_gap_sec_params_reply(evt->evt.gap_evt.conn_handle,
						      BLE_GAP_SEC_STATUS_PAIRING_NOT_SUPP,
						      NULL, NULL);
		if (nrf_err) {
			LOG_ERR("Failed to reply with security params, nrf_error %#x", nrf_err);
		}
		break;

	case BLE_GATTS_EVT_SYS_ATTR_MISSING:
		nrf_err = sd_ble_gatts_sys_attr_set(evt->evt.gatts_evt.conn_handle, NULL, 0, 0);
		if (nrf_err) {
			LOG_ERR("Failed to set missing system attributes, nrf_error %#x",
				nrf_err);
		}
		break;

	default:
		break;
	}
}
NRF_SDH_BLE_OBSERVER(sdh_ble, on_ble_evt, NULL, USER_LOW);

static void on_conn_params_evt(const struct ble_conn_params_evt *evt)
{
	uint32_t nrf_err;

	switch (evt->evt_type) {
	case BLE_CONN_PARAMS_EVT_REJECTED:
		nrf_err = sd_ble_gap_disconnect(evt->conn_handle,
						BLE_HCI_CONN_INTERVAL_UNACCEPTABLE);
		if (nrf_err) {
			LOG_ERR("Failed to disconnect, nrf_error %#x", nrf_err);
		}
		break;

	case BLE_CONN_PARAMS_EVT_ATT_MTU_UPDATED:
		LOG_INF("ATT MTU updated: %u", evt->att_mtu);
		break;

	case BLE_CONN_PARAMS_EVT_DATA_LENGTH_UPDATED:
		LOG_INF("Data length updated: tx %u rx %u",
			evt->data_length.tx,
			evt->data_length.rx);
		break;

	case BLE_CONN_PARAMS_EVT_ERROR:
		LOG_ERR("Connection parameter error, nrf_error %#x", evt->error.reason);
		break;

	default:
		break;
	}
}

static void ble_adv_evt_handler(struct ble_adv *adv, const struct ble_adv_evt *evt)
{
	ARG_UNUSED(adv);

	switch (evt->evt_type) {
	case BLE_ADV_EVT_ERROR:
		LOG_ERR("Advertising error, nrf_error %#x", evt->error.reason);
		break;
	case BLE_ADV_EVT_IDLE:
		LOG_INF("Advertising stopped");
		break;
	default:
		break;
	}
}

static void button_handler(uint8_t pin, enum bm_buttons_evt_type action)
{
	static bool time_measure_start;
	int err;

	switch (pin) {
	case BOARD_PIN_BTN_0:
		if (action != BM_BUTTONS_PRESS) {
			break;
		}

		time_measure_start = !time_measure_start;
		if (time_measure_start) {
			err = MEMFAULT_METRIC_TIMER_START(button_elapsed_time_ms);
			if (err) {
				LOG_ERR("Failed to start button timer metric, err %d", err);
			} else {
				LOG_INF("Button0 - button_elapsed_time_ms metric timer started");
			}
		} else {
			err = MEMFAULT_METRIC_TIMER_STOP(button_elapsed_time_ms);
			if (err) {
				LOG_ERR("Failed to stop button timer metric, err %d", err);
			} else {
				LOG_INF("Button0 - button_elapsed_time_ms metric timer stopped");
			}

			memfault_heartbeat_pending = true;
			LOG_INF("Memfault heartbeat scheduled");
		}
		break;

	case BOARD_PIN_BTN_1:
		MEMFAULT_TRACE_EVENT_WITH_LOG(button_state_changed, "Button1 state: %u",
					      (uint32_t)(action == BM_BUTTONS_PRESS));
		LOG_INF("Button1 - button_state_changed event tracked, button 1 state: %u",
			(uint32_t)(action == BM_BUTTONS_PRESS));
		break;

	case BOARD_PIN_BTN_2:
		if (action != BM_BUTTONS_PRESS) {
			break;
		}

		err = MEMFAULT_METRIC_ADD(button_press_count, 1);
		if (err) {
			LOG_ERR("Failed to increase button_press_count metric, err %d", err);
		} else {
			LOG_INF("Button2 - button_press_count metric increased");
		}
		break;

	case BOARD_PIN_BTN_3: {
		if (action != BM_BUTTONS_PRESS) {
			break;
		}

		volatile uint32_t div;

		LOG_INF("Division by zero will now be triggered");
#pragma GCC diagnostic push
#pragma GCC diagnostic ignored "-Wdiv-by-zero"
		div = 1 / 0;
#pragma GCC diagnostic pop
		ARG_UNUSED(div);
		break;
	}

	default:
		break;
	}
}

int main(void)
{
	int err;
	uint32_t nrf_err;
	ble_gap_conn_sec_mode_t device_name_write_sec;
	struct bm_buttons_config button_configs[] = {
		{
			.pin_number = BOARD_PIN_BTN_0,
			.active_state = BM_BUTTONS_ACTIVE_LOW,
			.pull_config = BM_BUTTONS_PIN_PULLUP,
			.handler = button_handler,
		},
		{
			.pin_number = BOARD_PIN_BTN_1,
			.active_state = BM_BUTTONS_ACTIVE_LOW,
			.pull_config = BM_BUTTONS_PIN_PULLUP,
			.handler = button_handler,
		},
		{
			.pin_number = BOARD_PIN_BTN_2,
			.active_state = BM_BUTTONS_ACTIVE_LOW,
			.pull_config = BM_BUTTONS_PIN_PULLUP,
			.handler = button_handler,
		},
		{
			.pin_number = BOARD_PIN_BTN_3,
			.active_state = BM_BUTTONS_ACTIVE_LOW,
			.pull_config = BM_BUTTONS_PIN_PULLUP,
			.handler = button_handler,
		},
	};
	struct ble_bas_config bas_cfg = {
		.can_notify = true,
		.battery_level = battery_level,
		.sec_mode = BLE_BAS_CONFIG_SEC_MODE_DEFAULT,
	};
	struct ble_dis_config dis_cfg = {
		.sec_mode = BLE_DIS_CONFIG_SEC_MODE_DEFAULT,
	};
	struct ble_mds_config mds_cfg = {
		.sec_mode = BLE_MDS_CONFIG_SEC_MODE_DEFAULT,
	};


	LOG_INF("BLE MDS sample started");

	leds_init();

	err = bm_timer_init(&battery_timer, BM_TIMER_MODE_REPEATED,
			    battery_level_timeout_handler);
	if (err) {
		LOG_ERR("Failed to initialize battery timer, err %d", err);
		goto idle;
	}

	err = bm_buttons_init(button_configs, ARRAY_SIZE(button_configs),
			      BM_BUTTONS_DETECTION_DELAY_MIN_US);
	if (err) {
		LOG_ERR("Failed to initialize buttons, err %d", err);
		goto idle;
	}

	err = bm_buttons_enable();
	if (err) {
		LOG_ERR("Failed to enable buttons, err %d", err);
		goto idle;
	}

	err = nrf_sdh_enable_request();
	if (err) {
		LOG_ERR("Failed to enable SoftDevice, err %d", err);
		goto idle;
	}

	LOG_INF("SoftDevice enabled");

	err = nrf_sdh_ble_enable(CONFIG_NRF_SDH_BLE_CONN_TAG);
	if (err) {
		LOG_ERR("Failed to enable BLE, err %d", err);
		goto idle;
	}

	LOG_INF("Bluetooth enabled");

	BLE_GAP_CONN_SEC_MODE_SET_NO_ACCESS(&device_name_write_sec);
	nrf_err = sd_ble_gap_device_name_set(&device_name_write_sec, CONFIG_SAMPLE_BLE_DEVICE_NAME,
					     strlen(CONFIG_SAMPLE_BLE_DEVICE_NAME));
	if (nrf_err) {
		LOG_ERR("Failed to set device name, nrf_error %#x", nrf_err);
		goto idle;
	}

	nrf_err = ble_conn_params_evt_handler_set(on_conn_params_evt);
	if (nrf_err) {
		LOG_ERR("Failed to setup conn param event handler, nrf_error %#x", nrf_err);
		goto idle;
	}

	nrf_err = ble_bas_init(&ble_bas, &bas_cfg);
	if (nrf_err) {
		LOG_ERR("Failed to initialize battery service, nrf_error %#x", nrf_err);
		goto idle;
	}

	nrf_err = ble_dis_init(&dis_cfg);
	if (nrf_err) {
		LOG_ERR("Failed to initialize device information service, nrf_error %#x", nrf_err);
		goto idle;
	}

	nrf_err = ble_mds_init(&ble_mds, &mds_cfg);
	if (nrf_err) {
		LOG_ERR("Failed to initialize Memfault Diagnostic Service, nrf_error %#x", nrf_err);
		goto idle;
	}

	ble_uuid_t adv_uuid_list[] = {
		{
			.uuid = BLE_UUID_MDS_SERVICE,
			.type = ble_mds_service_uuid_type(&ble_mds),
		},
		{
			.uuid = BLE_UUID_BATTERY_SERVICE,
			.type = BLE_UUID_TYPE_BLE,
		},
	};
	struct ble_adv_config adv_cfg = {
		.conn_cfg_tag = CONFIG_NRF_SDH_BLE_CONN_TAG,
		.evt_handler = ble_adv_evt_handler,
		.adv_data = {
			.name_type = BLE_ADV_DATA_FULL_NAME,
			.flags = BLE_GAP_ADV_FLAGS_LE_ONLY_GENERAL_DISC_MODE,
		},
		.sr_data.uuid_lists.complete = {
			.len = ARRAY_SIZE(adv_uuid_list),
			.uuid = &adv_uuid_list[0],
		},
	};

	nrf_err = ble_adv_init(&ble_adv, &adv_cfg);
	if (nrf_err) {
		LOG_ERR("Failed to initialize advertising, nrf_error %#x", nrf_err);
		goto idle;
	}

	LOG_INF("BLE MDS sample initialized");

	err = bm_timer_start(&battery_timer,
			     BM_TIMER_MS_TO_TICKS(
				     CONFIG_SAMPLE_BLE_MDS_BATTERY_LEVEL_MEAS_INTERVAL),
			     NULL);
	if (err) {
		LOG_ERR("Failed to start battery timer, err %d", err);
		goto idle;
	}

	nrf_gpio_pin_write(RUN_STATUS_LED, BOARD_LED_ACTIVE_STATE);

	nrf_err = ble_adv_start(&ble_adv, BLE_ADV_MODE_FAST);
	if (nrf_err) {
		LOG_ERR("Failed to start advertising, nrf_error %#x", nrf_err);
		goto idle;
	}

	LOG_INF("Advertising as %s", CONFIG_SAMPLE_BLE_DEVICE_NAME);

idle:
	while (true) {
		memfault_metrics_timer_process();
		/* bm_buttons invokes handlers from k_timer ISR; flush pending trace events here. */
		memfault_trace_event_try_flush_isr_event();
		if (memfault_heartbeat_pending) {
			memfault_heartbeat_pending = false;
			memfault_metrics_heartbeat_debug_trigger();
		}
		ble_mds_process(&ble_mds);

		log_flush();

		k_cpu_idle();
	}

	return 0;
}
```
