## drivers/clock_control/Kconfig
```kconfig
#
# Copyright (c) 2024 Nordic Semiconductor
#
# SPDX-License-Identifier: LicenseRef-Nordic-5-Clause
#

if CLOCK_CONTROL

config CLOCK_CONTROL_SDH
	bool
	depends on NRF_SDH
	select CLOCK_CONTROL_NRF_FORCE_ALT
	default y
	help
	  Use SoftDevice compatible clock driver.

endif # CLOCK_CONTROL
```

## samples/peripherals/spi/Kconfig
```kconfig
#
# Copyright (c) 2026 Nordic Semiconductor ASA
#
# SPDX-License-Identifier: LicenseRef-Nordic-5-Clause
#

menu "SPI sample"

config SAMPLE_SPI_MSG
	string "Message to send over SPI"
	default "Hello World!"
	help
	  The message that the SPI master sends to the SPI slave when the button is pressed.

config SAMPLE_SPI_RX_BUF_SIZE
	int "Size of the SPI slave receive buffer"
	default 32
	help
	  Maximum number of bytes the SPI slave can receive in a single transfer.
	  Increase this if the SPI master will send messages longer than the default.

module=SAMPLE_SPI
module-str=SPI Sample
source "$(ZEPHYR_BASE)/subsys/logging/Kconfig.template.log_config"

endmenu # "SPI sample"

source "Kconfig.zephyr"
```
